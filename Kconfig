## Kconfig
```kconfig
osource "dependencies/zmk-feature-custom-settings/Kconfig"

config ZMK_LED_BRIGHTNESS
    bool "Persisted keyboard LED brightness"
    select ZMK_CUSTOM_SETTINGS

if ZMK_LED_BRIGHTNESS

config ZMK_LED_BRIGHTNESS_STUDIO_RPC
    bool "Control LED brightness through ZMK Studio"
    depends on ZMK_STUDIO

endif
```
